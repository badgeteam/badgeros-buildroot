## package/picocom/Config.in.host
```kconfig
config BR2_PACKAGE_HOST_PICOCOM
	bool "host picocom"
	help
	  picocom is a minimal dumb-terminal emulation program. It is,
	  in principle, very much like minicom, only it's pico instead
	  of mini!

	  https://github.com/npat-efault/picocom/
```

## package/python-bitstring/Config.in.host
```kconfig
config BR2_PACKAGE_HOST_PYTHON_BITSTRING
	bool "host python-bitstring"
	help
	  Simple construction, analysis and modification of binary data.

	  https://github.com/scott-griffiths/bitstring
```

## package/python-cffi/Config.in.host
```kconfig
config BR2_PACKAGE_HOST_PYTHON_CFFI
	bool "host python-cffi"
	select BR2_PACKAGE_HOST_LIBFFI
	select BR2_PACKAGE_HOST_PYTHON_PYCPARSER # runtime
	help
	  This is the Foreign Function Interface for Python calling C
	  code. The aim of this project is to provide a convenient
	  and reliable way of calling C code from Python.

	  https://pypi.python.org/pypi/cffi
```

## package/python-cryptography/Config.in.host
```kconfig
config BR2_PACKAGE_HOST_PYTHON_CRYPTOGRAPHY
	bool "host python-cryptography"
	select BR2_PACKAGE_HOST_PYTHON_CFFI # runtime
	select BR2_PACKAGE_HOST_PYTHON3_SSL
	help
	  cryptography is a package designed to expose cryptographic
	  primitives and recipes to Python developers.

	  https://cryptography.io
```

## package/python-ecdsa/Config.in.host
```kconfig
config BR2_PACKAGE_HOST_PYTHON_ECDSA
	bool "host python-ecdsa"
	select BR2_PACKAGE_HOST_PYTHON_SIX # runtime
	help
	  ECDSA cryptographic signature library (pure python).

	  http://github.com/tlsfuzzer/python-ecdsa
```

## package/python-esptool/Config.in.host
```kconfig
config BR2_PACKAGE_HOST_PYTHON_ESPTOOL
	bool "host python-esptool"
	select BR2_PACKAGE_HOST_PYTHON_BITSTRING # runtime
	select BR2_PACKAGE_HOST_PYTHON_CRYPTOGRAPHY # runtime
	select BR2_PACKAGE_HOST_PYTHON_ECDSA # runtime
	select BR2_PACKAGE_HOST_PYTHON_REEDSOLO # runtime
	select BR2_PACKAGE_HOST_PYTHON_SERIAL # runtime
	select BR2_PACKAGE_HOST_PYTHON3_ZLIB
	help
	  A serial utility to communicate & flash code to Espressif
	  ESP8266 & ESP32 chips.

	  https://github.com/espressif/esptool
```

## package/python-pycparser/Config.in.host
```kconfig
config BR2_PACKAGE_HOST_PYTHON_PYCPARSER
	bool "host python-pycparser"
	help
	  C parser in Python

	  https://github.com/eliben/pycparser
```

## package/python-reedsolo/Config.in.host
```kconfig
config BR2_PACKAGE_HOST_PYTHON_REEDSOLO
	bool "host python-reedsolo"
	help
	  Pure-Python Reed Solomon encoder/decoder.

	  https://github.com/tomerfiliba/reedsolomon
```
